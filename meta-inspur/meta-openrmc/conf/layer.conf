## meta-inspur/meta-openrmc/conf/layer.conf
```bitbake
# We have a conf and classes directory, add to BBPATH
BBPATH .= ":${LAYERDIR}"

# We have recipes-* directories, add to BBFILES
BBFILES += "${LAYERDIR}/recipes-*/*/*.bb \
            ${LAYERDIR}/recipes-*/*/*.bbappend"

BBFILE_COLLECTIONS += "openrmc-layer"
BBFILE_PATTERN_openrmc-layer = ""
BBFILE_PRIORITY_openrmc-layer = "5"
LAYERSERIES_COMPAT_openrmc-layer = "warrior"
```
